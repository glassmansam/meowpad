#include "meowpad.dtsi"

/ {
    kscan0: kscan {
        compatible = "zmk,kscan-gpio-matrix";
        wakeup-source;

        diode-direction = "col2row";

        col-gpios
            = <&pro_micro 9 GPIO_ACTIVE_HIGH>  /* D9/A9  -> P1.06 -> 106 */
            , <&pro_micro 8 GPIO_ACTIVE_HIGH>  /* D8/A8  -> P1.04 -> 104 */
            , <&pro_micro 6 GPIO_ACTIVE_HIGH>  /* D6/A7  -> P1.00 -> 100 swapped > */
            , <&pro_micro 7 GPIO_ACTIVE_HIGH>  /* D7     -> P0.11 -> 011 swapped ^ */
            /* swapped last two cols */
            ;

        row-gpios
            = <&pro_micro 15 (GPIO_ACTIVE_HIGH | GPIO_PULL_DOWN)>  /* D15     -> P1.13 -> 113 */
            , <&pro_micro 14 (GPIO_ACTIVE_HIGH | GPIO_PULL_DOWN)>  /* D14     -> P1.11 -> 111 */
            , <&pro_micro 16 (GPIO_ACTIVE_HIGH | GPIO_PULL_DOWN)>  /* D16     -> P0.10 -> 010 */
            , <&pro_micro 10 (GPIO_ACTIVE_HIGH | GPIO_PULL_DOWN)>  /* D10/A10 -> P0.09 -> 009 */
            ;
    };

    encoder: encoder {
        compatible = "alps,ec11";
        a-gpios = <&pro_micro 21 (GPIO_ACTIVE_HIGH | GPIO_PULL_UP)>; /* D21/A3 -> P0.31 -> 031 */ 
        b-gpios = <&pro_micro 20 (GPIO_ACTIVE_HIGH | GPIO_PULL_UP)>; /* D20/A2 -> P0.29 -> 029 */
        steps = <80>;
        status = "okay";
    };

    sensors: sensors {
        compatible = "zmk,keymap-sensors";
        sensors = <&encoder>;
        triggers-per-rotation = <20>;
    };
};
